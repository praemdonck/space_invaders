#include <stdbool.h>
#include <stddef.h>
#include "tm4c123gh6pm.h"
#include "sound.h"

#define DAC_PORT       (*((volatile unsigned long *)0x4000503C))

/* Sound DATA. As the DAC is only 4 bits, each byte packs two samples to optimize memory usage */
const unsigned char FAST_INVADER_0[491] = {
 0x87, 0x64, 0x31, 0x11, 0x12, 0x34, 0x67, 0x89, 0xac, 0xce, 0xef, 0xff, 0xff, 0xff, 0xff, 0xff, 0xfe, 0xed, 0xdc, 0xcb,
 0xaa, 0x99, 0x88, 0x77, 0x66, 0x54, 0x43, 0x44, 0x45, 0x56, 0x66, 0x65, 0x44, 0x32, 0x20, 0x00, 0x00, 0x00, 0x00, 0x00,
 0x00, 0x00, 0x00, 0x00, 0x00, 0x00, 0x12, 0x23, 0x44, 0x56, 0x78, 0x89, 0x9a, 0xbc, 0xdd, 0xee, 0xff, 0xff, 0xff, 0xff,
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 0x77, 0x77, 0x77, 0x77, 0x77, 0x77, 0x77, 0x77, 0x77, 0x77, 0x77 };


const unsigned char FAST_INVADER_1[521] = {
 0x88, 0x76, 0x43, 0x21, 0x11, 0x23, 0x46, 0x78, 0x9a, 0xbc, 0xde, 0xef, 0xff, 0xff, 0xff, 0xff, 0xff, 0xee, 0xdd, 0xdc,
 0xcb, 0xa9, 0x98, 0x88, 0x76, 0x65, 0x54, 0x43, 0x34, 0x45, 0x66, 0x66, 0x55, 0x44, 0x22, 0x10, 0x00, 0x00, 0x00, 0x00,
 0x00, 0x00, 0x00, 0x00, 0x00, 0x00, 0x11, 0x23, 0x34, 0x46, 0x67, 0x88, 0x9a, 0xab, 0xcc, 0xde, 0xef, 0xff, 0xff, 0xff,
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 0x88, 0x88, 0x88, 0x78, 0x77, 0x88, 0x78, 0x77, 0x77, 0x77, 0x77, 0x77, 0x77, 0x77, 0x77, 0x77, 0x77, 0x77, 0x77, 0x77,
 0x77 };

const unsigned char FAST_INVADER_2[527] = {
 0x88, 0x88, 0x88, 0x87, 0x64, 0x32, 0x11, 0x12, 0x34, 0x67, 0x89, 0xac, 0xde, 0xef, 0xff, 0xff, 0xff, 0xff, 0xff, 0xff,
 0xee, 0xdd, 0xcc, 0xba, 0xa9, 0x98, 0x87, 0x76, 0x55, 0x44, 0x34, 0x45, 0x56, 0x66, 0x66, 0x44, 0x32, 0x11, 0x00, 0x00,
 0x00, 0x00, 0x00, 0x00, 0x00, 0x00, 0x00, 0x00, 0x00, 0x12, 0x33, 0x45, 0x67, 0x78, 0x89, 0xaa, 0xbc, 0xcd, 0xee, 0xff,
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 0x99, 0x99, 0x99, 0x99, 0x99, 0x99, 0x99 };


const unsigned char FAST_INVADER_3[549] = {
 0x88, 0x88, 0x88, 0x88, 0x98, 0x88, 0x88, 0x88, 0x88, 0x88, 0x88, 0x88, 0x88, 0x65, 0x32, 0x11, 0x12, 0x34, 0x66, 0x89,
 0xac, 0xde, 0xef, 0xff, 0xff, 0xff, 0xff, 0xff, 0xff, 0xfe, 0xed, 0xdc, 0xca, 0xa9, 0x88, 0x87, 0x76, 0x55, 0x44, 0x44,
 0x44, 0x56, 0x66, 0x66, 0x54, 0x33, 0x21, 0x00, 0x00, 0x00, 0x00, 0x00, 0x00, 0x00, 0x00, 0x00, 0x00, 0x00, 0x01, 0x22,
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 0x77, 0x77, 0x77, 0x77, 0x77, 0x77, 0x77, 0x77, 0x77 };


const unsigned char SHOOT[2040] = {
 0x86, 0x6a, 0xd8, 0x27, 0xd7, 0x36, 0x9e, 0xa4, 0x5a, 0xc6, 0x58, 0xd8, 0x36, 0x8d, 0xa5, 0x58, 0xc7, 0x48, 0xd9, 0x47,
 0x9b, 0x73, 0x8d, 0x85, 0x7d, 0xf6, 0x35, 0xa7, 0x25, 0x9d, 0xcc, 0xc7, 0x61, 0x05, 0xa7, 0x8f, 0xff, 0x70, 0x00, 0x00,
 0x6f, 0xff, 0xff, 0xc0, 0x00, 0x1b, 0xa9, 0xff, 0xfb, 0x20, 0x01, 0x04, 0xaf, 0xff, 0xff, 0x40, 0x03, 0x43, 0x8d, 0xff,
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 0x88, 0x88, 0x88, 0x88, 0x88, 0x88, 0x88, 0x88, 0x88, 0x88, 0x88, 0x88, 0x88, 0x88, 0x88, 0x88, 0x88, 0x88, 0x88, 0x88 };

const unsigned char ENEMY_KILLED[1689] = {
 0x88, 0x88, 0x88, 0x88, 0x88, 0x88, 0x88, 0x88, 0x88, 0x88, 0x88, 0x88, 0x88, 0x88, 0x88, 0x88, 0x88, 0x88, 0x88, 0x88,
 0x88, 0x88, 0x88, 0x88, 0x88, 0x88, 0x88, 0x88, 0x88, 0x88, 0x88, 0x88, 0x88, 0x88, 0x88, 0x88, 0x88, 0x88, 0x88, 0x88,
 0x88, 0x88, 0x88, 0x88, 0x88, 0x88, 0x88, 0x88, 0x9a, 0x97, 0x66, 0x67, 0x88, 0x77, 0x8a, 0xa7, 0x69, 0xc7, 0x5a, 0xd7,
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 0x78, 0xa9, 0x77, 0x79, 0x97, 0x78, 0x8a, 0x77 };



 const unsigned char BIG_EXPLOSION[4366] = {
 0x87, 0x77, 0x88, 0x88, 0x88, 0x87, 0x77, 0x88, 0x89, 0x88, 0x76, 0x66, 0x67, 0x89, 0x98, 0x87, 0x66, 0x67, 0x77, 0x87,
 0x88, 0x99, 0xab, 0xbb, 0xa9, 0x87, 0x65, 0x55, 0x55, 0x56, 0x89, 0x99, 0x99, 0xab, 0xba, 0x87, 0x77, 0x77, 0x99, 0x98,
 0x89, 0xab, 0xbc, 0xcc, 0xba, 0x97, 0x52, 0x00, 0x00, 0x11, 0x35, 0x78, 0x89, 0x9b, 0xcd, 0xdd, 0xcb, 0xbd, 0xff, 0xff,
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 0x88, 0x88, 0x88, 0x88, 0x88 };
 
/* Enum that describe the different types of sound
 * that can be played. The sound with higher position 
 * have priority over the lower priority. ie an explosion
 * can override the tempo sound */ 
typedef enum
{
  INVADERS_TEMPO,
  SHOOT_SOUND,
  ENEMY_KILLED_SOUND,
  EXPLOSION_SOUND
} sound_types_e;

/* Data structure used to control the sound module */
typedef struct
{
  sound_types_e type;
  bool          active;
  const unsigned char* samples;
  size_t        length;
  size_t        counter;
} sound_control_t;

sound_control_t sound_control;

/* Init sys tick, assume that GPIO is already configured */
void sound_init(void)
{
    NVIC_ST_CTRL_R = 0;             // disable SysTick during setup
  	NVIC_ST_RELOAD_R = 0x1C68;      // reload value for 11KHz interrupt rate (assuming 80MHz)
    NVIC_ST_CTRL_R = 0x00000005;    // Disable systick for now
    sound_control.active = false;
}


/* Start playing a sound. This function check if the new sound file can be
 * started. The function enables the systick and the interrupts */
void sound_play(const unsigned char* data, size_t length, sound_types_e type)
{
  if (!sound_control.active || type >= sound_control.type)
  {
    NVIC_ST_CTRL_R = 5;
    sound_control.counter = 0;
    sound_control.length = length;
    sound_control.samples = data;
    sound_control.active = true;
    sound_control.type = type;
    DAC_PORT = sound_control.samples[0] >> 4;
    NVIC_ST_CURRENT_R = 0;
    NVIC_ST_CTRL_R = 7;
  }
}

/* Systick handler outputs new sample to DAC */
void SysTick_Handler(void)
{
  if (sound_control.active)
  {
    sound_control.counter++;

    /* Unpack the samples from the bytes. Even samples are stored in
     * the least significant nibble and odd samples are in the 
     * most significant nibble */
    if (sound_control.counter % 2)
      DAC_PORT = sound_control.samples[sound_control.counter / 2];
    else
      DAC_PORT = sound_control.samples[sound_control.counter / 2] >> 4;

    // Check for the end of the file
    if (sound_control.counter >= sound_control.length) 
    {
      sound_control.active = false;
      NVIC_ST_CTRL_R = 5;            // disable sys_timer
    }
  }
}


/* Functions to start playing the various sound files */
void sound_play_shoot(void)
{
  sound_play(SHOOT, sizeof(SHOOT) * 2, SHOOT_SOUND);
}

void sound_play_enemy_killed(void)
{
  sound_play(ENEMY_KILLED, sizeof(ENEMY_KILLED) * 2, ENEMY_KILLED_SOUND);
}

void sound_play_big_explosion(void)
{
  sound_play(BIG_EXPLOSION, sizeof(BIG_EXPLOSION) * 2, EXPLOSION_SOUND);
}
  
void sound_play_fast_invader(unsigned int t)
{
  switch (t)
  {
    case 0:
      sound_play(FAST_INVADER_0, sizeof(FAST_INVADER_0) * 2, INVADERS_TEMPO);
      break;
    case 1:
      sound_play(FAST_INVADER_1, sizeof(FAST_INVADER_1) * 2, INVADERS_TEMPO);
      break;
    case 2:
      sound_play(FAST_INVADER_2, sizeof(FAST_INVADER_2) * 2, INVADERS_TEMPO);
      break;
    default:
      sound_play(FAST_INVADER_3, sizeof(FAST_INVADER_3) * 2, INVADERS_TEMPO);
  }
}

